## manifest-repo/west.yml
```yaml
manifest:
  # lowest version of the manifest file schema that can parse this file’s data
  version: 0.13

  projects:
    - name: doxygen-awesome
      url: https://github.com/jothepro/doxygen-awesome-css
      # you can also use SSH instead of HTTPS:
      # url: git@github.com:jothepro/doxygen-awesome-css.git
      revision: main
      path: deps/utilities/doxygen-awesome-css
    - name: zephyr
      revision: v4.4.0
      url: https://github.com/zephyrproject-rtos/zephyr
      # path: deps/zephyr
      # explicitly add Zephyr-specific west extensions
      # west-commands: scripts/west-commands.yml
      import:
        path-prefix: deps
        file: west.yml # not strictly needed since it is the value by default
        name-allowlist:
          - cmsis_6
          - hal_nordic 
    - name: zpp_lib
      url: https://github.com/AdvEmbSof/zpp_lib.git
      revision: v1.5
      path: deps/zpp_lib
```
