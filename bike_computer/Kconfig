## bike_computer/Kconfig
```kconfig
menu "Zephyr"
source "Kconfig.zephyr"
endmenu

module = APP
module-str = APP
source "subsys/logging/Kconfig.template.log_config"

config BIKE_COMPUTER_STATIC_SCHEDULING
  bool "Build system with static scheduling"
  default n
  help
    This option must be enabled to use the static scheduling version.

config LOG_TASK_TIMES
  bool "Log task times for debugging purposes"
  default n
  help
    This option must be enabled to log task times with the TaskManager class
    This option must be disabled for test and production

config APP_LOG_LEVEL_DEBUG
  bool "Log for debugging purposes"
  default n
  help
    This option must be disabled for test and production
```

## bike_computer/tests/sensor_device/Kconfig
```kconfig
menu "Zephyr"
source "Kconfig.zephyr"
endmenu

module = APP
module-str = APP
source "subsys/logging/Kconfig.template.log_config"

config BIKE_COMPUTER_STATIC_SCHEDULING
	bool "Use static scheduling (phase A)"
	default n
	help
	  Run the bike computer tasks with a static (cyclic) schedule.
```

## bike_computer/tests/speedometer/Kconfig
```kconfig
# SPDX-License-Identifier: Apache-2.0

module = APP
module-str = APP
source "subsys/logging/Kconfig.template.log_config"

rsource "../../Kconfig"
```

## bike_computer/tests/speedometer/testcase.yaml
```yaml
tests:
  bike_computer.speedometer:
    tags:
      - bike_computer
      - phase_b
    timeout: 120
    extra_conf_files:
      - ../../../deps/zpp_lib/configs/prj.conf
      - ../../../deps/zpp_lib/configs/prj_test.conf
    extra_args:
      - platform:qemu_x86/atom:CONFIG_SYS_CLOCK_TICKS_PER_SEC=5000
      - platform:qemu_x86/atom:DTC_OVERLAY_FILE=../../../deps/zpp_lib/configs/boards/qemu_x86.overlay
      - platform:nrf5340dk/nrf5340/cpuapp:DTC_OVERLAY_FILE=../../../deps/zpp_lib/configs/boards/nrf5340dk_nrf5340_cpuapp.overlay
```
